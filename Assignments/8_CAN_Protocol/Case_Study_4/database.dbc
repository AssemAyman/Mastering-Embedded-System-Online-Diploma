VERSION ""

NS_ :

BS_:

BU_: ECU2 ECU1

BO_ 939 ECU2_MSG: 1 ECU2
 SG_ Speed : 0|8@1+ (1,0) [0|255] ""  ECU1

BO_ 48 ECU1_MSG: 1 ECU1
 SG_ Acc_or_DeAcc : 0|8@1+ (1,0) [0|1] ""  ECU2
